#include "casuarina-audio.dtsi"

&soc {
	qcom,board_id {
		compatible = "qcom,board_id";
		board_id0_read = <&tlmm 90 0>;
		board_id1_read = <&tlmm 91 0>;
		board_id2_read = <&tlmm 92 0>;
		board_id3_read = <&tlmm 93 0>;
		status = "ok";
	};
};

/ {
	/delete-node/ qcom,battery-data;

	mtp_batterydata: qcom,battery-data {
		qcom,batt-id-range-pct = <15>;
		#include "qg-batterydata-V430-4950mah-300k.dtsi"
		#include "qg-batterydata-V430-5000mah-300k.dtsi"
	};
};
